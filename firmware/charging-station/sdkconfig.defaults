## firmware/charging-station/sdkconfig.defaults
```kconfig
CONFIG_IDF_TARGET_ESP32C3=y
CONFIG_FREERTOS_HZ=1000
CONFIG_ESP_MAIN_TASK_STACK_SIZE=4096
CONFIG_ESP_WIFI_SSID=""
CONFIG_ESP_WIFI_PASSWORD=""
```

## firmware/sdkconfig.defaults
```kconfig
# ESP32-S3 config
CONFIG_IDF_TARGET="esp32s3"
CONFIG_ESP32S3_DEFAULT_CPU_FREQ_240=y
CONFIG_ESP32S3_DATA_CACHE_64KB=y
CONFIG_ESP32S3_INSTRUCTION_CACHE_32KB=y
CONFIG_SPIRAM=y
CONFIG_SPIRAM_MODE_OCT=y
CONFIG_SPIRAM_SPEED_80M=y
CONFIG_SPIRAM_USE_CAPS_ALLOC=y
CONFIG_SPIRAM_IGNORE_NOTFOUND=y
CONFIG_ESP32S3_SPIRAM_SUPPORT=y

# FreeRTOS
CONFIG_FREERTOS_HZ=1000
CONFIG_FREERTOS_USE_TICKLESS_IDLE=y
CONFIG_FREERTOS_NUMBER_OF_CORES=2
CONFIG_FREERTOS_ENABLE_TASK_SNAPSHOT=y

# WiFi
CONFIG_ESP_WIFI_STA_RECONNECT=y
CONFIG_ESP_MAXIMUM_RETRY=5

# BLE
CONFIG_BT_ENABLED=y
CONFIG_BT_BLE_ENABLED=y
CONFIG_BT_BLE_50_FEATURES_SUPPORTED=y
CONFIG_BT_CONTROLLER_ONLY=y

# SPI
CONFIG_SPI_MASTER_IN_IRAM=y

# I2C
CONFIG_I2C_MASTER_IN_IRAM=y

# I2S
CONFIG_I2S_ISR_IRAM_SAFE=y

# OTA
CONFIG_BOOTLOADER_APP_ROLLBACK_ENABLE=y
CONFIG_BOOTLOADER_SKIP_VALIDATE_IN_DEEP_SLEEP=y

# Watchdog
CONFIG_ESP_TASK_WDT_TIMEOUT_S=3
CONFIG_ESP_TASK_WDT_PANIC=y

# Logging
CONFIG_LOG_DEFAULT_LEVEL_INFO=y
```
